#include <Wire.h>
#include <U8g2lib.h>

#define I2C_ADDRESS   0x3C
#define SCREEN_W      128
#define SCREEN_H    64
#define LINE_HEIGHT   18       // matches ~6×18 font
#define MAX_WORDS     32
#define MAX_LINES     3        // up to 3 lines
#define BUF_SIZE      64      // smaller to save RAM


// 'CPECLOGOFORC', 128x32px
const unsigned char epd_bitmap [] PROGMEM = {
	0x00, 0x00, 0x00, 0x00, 0x00, 0x00, 0x00, 0x00, 0x00, 0x00, 0x00, 0x00, 0x00, 0x00, 0x00, 0x00, 
	0x00, 0x00, 0x00, 0x00, 0x00, 0x00, 0x00, 0x00, 0x00, 0x00, 0x00, 0x00, 0x00, 0x00, 0x00, 0x00, 
	0x00, 0x00, 0x00, 0x00, 0x00, 0x00, 0x00, 0x00, 0x00, 0x00, 0x00, 0x00, 0x00, 0x00, 0x00, 0x00, 
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	0x00, 0x00, 0x00, 0x00, 0x00, 0x00, 0x00, 0x00, 0x00, 0x00, 0x00, 0x00, 0x00, 0x00, 0x00, 0x00
};

// full‐buffer SH1106 over hardware I²C
U8G2_SH1106_128X64_NONAME_F_HW_I2C u8g2(U8G2_R0, /* reset=*/ U8X8_PIN_NONE);

// Fade entire buffer in over `ms` ms
void fadeIn(uint16_t ms, uint8_t steps = 32) {
  uint16_t delayPer = ms / steps;
  for (uint8_t s = 0; s <= steps; s++) {
    u8g2.setContrast(map(s, 0, steps, 0, 255));
    u8g2.sendBuffer();
    delay(delayPer);
  }
}

// Fade entire buffer out over `ms` ms
void fadeOut(uint16_t ms, uint8_t steps = 32) {
  uint16_t delayPer = ms / steps;
  for (uint8_t s = 0; s <= steps; s++) {
    u8g2.setContrast(map(s, 0, steps, 255, 0));
    u8g2.sendBuffer();
    delay(delayPer);
  }
  // clear after fade
  u8g2.clearBuffer();
  u8g2.sendBuffer();
  u8g2.setContrast(255);
}

// draw the bitmap from PROGMEM
// Show logo with fade-in then fade-out
void showLogo(uint16_t fadeTime = 1000) {
  u8g2.clearBuffer();
  u8g2.drawXBMP(0, 0, SCREEN_W, SCREEN_H, epd_bitmap);
  u8g2.sendBuffer();
  fadeIn(fadeTime);
  delay(500);
  fadeOut(fadeTime);
}

// measure a C-string’s pixel width
inline uint8_t textW(const char *s) {
  return u8g2.getStrWidth(s);
}

// split buf into words[], returns word count
uint8_t tokenize(char *buf, char *words[], uint8_t maxWords) {
  uint8_t wc = 0;
  char *p = buf;
  while (wc < maxWords && *p) {
    // skip spaces
    while (*p == ' ') p++;
    if (!*p) break;
    words[wc++] = p;
    // find end of this word
    while (*p && *p != ' ') p++;
    if (*p) *p++ = '\0';
  }
  return wc;
}

// justify & draw one line of wc words at vertical position y
void justifyLine(char *words[], uint8_t wc, int16_t y) {
  if (wc == 0) return;
  if (wc == 1) {
    u8g2.drawStr(0, y, words[0]);
    return;
  }
  int16_t totalW = 0;
  for (uint8_t i = 0; i < wc; i++) {
    totalW += textW(words[i]);
  }
  int16_t gaps  = wc - 1;
  int16_t space = SCREEN_W - totalW;
  int16_t extra = space / gaps;
  int16_t rem   = space % gaps;

  int16_t x = 0;
  for (uint8_t i = 0; i < wc; i++) {
    u8g2.drawStr(x, y, words[i]);
    x += textW(words[i]);
    if (i < wc - 1) {
      x += extra + (i < rem ? 1 : 0);
    }
  }
}

// animated, word-by-word justified display
void displayJustifiedAnimated(const char *msg,
                              uint16_t wordDelay,
                              const uint8_t maxWordsLine[]) {
  char buf[BUF_SIZE];
  strncpy(buf, msg, BUF_SIZE - 1);
  buf[BUF_SIZE - 1] = '\0';

  char *words[MAX_WORDS];
  uint8_t wcount = tokenize(buf, words, MAX_WORDS);
  if (wcount == 0) return;

  for (uint8_t shown = 1; shown <= wcount; shown++) {
    uint8_t lineStart[MAX_LINES] = {0};
    uint8_t lineCount[MAX_LINES] = {0};
    uint8_t linesUsed = 1;
    int16_t curW = 0;

    for (uint8_t w = 0; w < shown; w++) {
      uint8_t lw = textW(words[w]);
      uint8_t ln = linesUsed - 1;

      if (lineCount[ln] == 0) {
        lineStart[ln] = w;
        lineCount[ln] = 1;
        curW = lw;
      }
      else if (lineCount[ln] + 1 <= maxWordsLine[ln]
               && curW + 2 + lw <= SCREEN_W) {
        curW += 2 + lw;
        lineCount[ln]++;
      }
      else if (linesUsed < MAX_LINES) {
        linesUsed++;
        ln = linesUsed - 1;
        lineStart[ln] = w;
        lineCount[ln] = 1;
        curW = lw;
      }
      else {
        break;
      }
    }

    u8g2.clearBuffer();
    u8g2.setFont(u8g2_font_helvR14_tr);
    for (uint8_t ln = 0; ln < linesUsed; ln++) {
      char **lnWords = &words[lineStart[ln]];
      uint8_t wc = lineCount[ln];
      int16_t y = LINE_HEIGHT + ln * LINE_HEIGHT;
      justifyLine(lnWords, wc, y);
    }
    u8g2.sendBuffer();
    delay(wordDelay);
  }
}

void setup() {
  u8g2.begin();
  showLogo();
  delay(2000);
}

void loop() {
  // per-line budgets for first line of lyrics
  const uint8_t budget1[MAX_LINES] = { 2, 1, 1 };
  displayJustifiedAnimated(
    "oh, 'wag kang tumingin ",
    750,
    budget1
  );
  delay(1000);

  // per-line budgets for second line
  const uint8_t budget2[MAX_LINES] = { 1, 1, 2 };
  displayJustifiedAnimated(
    "nang ganyan sa akin",
    1100,
    budget2
  );
  delay(1000);
  // per-line budgets for second line
  const uint8_t budget3[MAX_LINES] = { 2, 2, 1 };
  displayJustifiedAnimated(
    "'wag mo akong kulitin",
    1100,
    budget3
  );
  delay(1000);

  // per-line budgets for second line
  //const uint8_t budget4[MAX_LINES] = { 2, 1, 1 };
  displayJustifiedAnimated(
    "'wag mo akong tanungin",
    1100,
    budget1
  );
  delay(7000);
  // per-line budgets for second line
  const uint8_t budget5[MAX_LINES] = { 1, 1, 1 };
  displayJustifiedAnimated(
    "dahil katulad mo",
    1800,
    budget5
  );
  delay(1000);

  // per-line budgets for second line
  //const uint8_t budget6[MAX_LINES] = { 2, 1, 1 };
  displayJustifiedAnimated(
    "ako rin ay nagbago",
    1000,
    budget1
  );
  delay(1000);

  // per-line budgets for second line
  const uint8_t budget7[MAX_LINES] = { 2, 2, 2 };
  displayJustifiedAnimated(
    "'di na tayo katulad ng dati",
    1000,
    budget7
  );
  delay(1000);

  // per-line budgets for second line
  //const uint8_t budget8[MAX_LINES] = { 2, 1, 1 };
  displayJustifiedAnimated(
    "kay bilis ng sandali",
    1000,
    budget1
  );
  delay(3000);

  // per-line budgets for second line
  //const uint8_t budget9[MAX_LINES] = { 2, 2, 2 };
  displayJustifiedAnimated(
    "oh, kay tagal din kitang minahal",
    1100,
    budget7
  );
  delay(4000);

  displayJustifiedAnimated(
    "oh, kay tagal din kitang minahal",
    1100,
    budget7
  );
  delay(7000);
}
