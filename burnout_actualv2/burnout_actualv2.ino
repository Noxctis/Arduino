
#include "Arduino_LED_Matrix.h"
#include <Wire.h>
#include <U8g2lib.h>

#define I2C_ADDRESS   0x3C
#define SCREEN_W      128
#define SCREEN_H      64
#define LINE_HEIGHT   18       // matches ~6×18 font
#define MAX_WORDS     32
#define MAX_LINES     3        // up to 3 lines
#define BUF_SIZE      64

// ------------------------------------------------
ArduinoLEDMatrix matrix;
U8G2_SH1106_128X64_NONAME_F_HW_I2C u8g2(U8G2_R0, /* reset=*/ U8X8_PIN_NONE);

// ------------------------------------------------
//  PROTOTYPES
// ------------------------------------------------
void displayJustifiedAnimated(const char *msg, uint16_t wordDelay, const uint8_t maxWordsLine[]);

// ------------------------------------------------
//  BITMAPS (LED MATRIX)
// ------------------------------------------------
uint8_t frame[8][12];

byte eye[8]     ={B00000000,B00111000,B00010000,B00010000,B00010000,B00010000,B00111000,B00000000};
byte bheart[8]  ={B01100110,B11111111,B11111111,B11111111,B01111110,B00111100,B00011000,B00000000};
byte sheart[8]  ={B00000000,B00000000,B01100110,B01111110,B00111100,B00011000,B00000000,B00000000};
byte youbmp[8]  ={B00000000,B01000010,B01000010,B01000010,B01000010,B01000010,B00111100,B00000000};

// 'CPECLOGOFORC', 128x32px
const unsigned char epd_bitmap [] PROGMEM = {
	0x00, 0x00, 0x00, 0x00, 0x00, 0x00, 0x00, 0x00, 0x00, 0x00, 0x00, 0x00, 0x00, 0x00, 0x00, 0x00, 
	0x00, 0x00, 0x00, 0x00, 0x00, 0x00, 0x00, 0x00, 0x00, 0x00, 0x00, 0x00, 0x00, 0x00, 0x00, 0x00, 
	0x00, 0x00, 0x00, 0x00, 0x00, 0x00, 0x00, 0x00, 0x00, 0x00, 0x00, 0x00, 0x00, 0x00, 0x00, 0x00, 
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	0x00, 0x00, 0x00, 0x00, 0x00, 0x00, 0x00, 0x00, 0x00, 0x00, 0x00, 0x00, 0x00, 0x00, 0x00, 0x00
};

// --- lyric state for non-blocking word-by-word ---
char   lyricBuffer[BUF_SIZE];
char*  lyricWords[MAX_WORDS];
uint8_t lyricWordCount = 0;
uint8_t lyricWordsShown = 0;
uint16_t currentWordDelay = 0;
uint8_t wordRow[MAX_WORDS];      // which row (0,1,2) each word belongs to

// ------------------------------------------------
//  LYRICS DATA
// ------------------------------------------------
const char* lyricText[] = {
  "oh, 'wag kang tumingin ",
  "nang ganyan sa akin",
  "'wag mo akong kulitin",
  "'wag mo akong tanungin",
  "dahil katulad mo",
  "ako rin ay nagbago",
  "'di na tayo katulad ng dati",
  "kay bilis ng sandali",
  "oh, kay tagal din kitang minahal",
  "oh, kay tagal din kitang minahal"
};

const uint16_t lyricDelay[] = {
  750, 1000, 900, 1050,
  1800, 850, 700, 1000,
  1150, 1250
};

const uint16_t lyricLineDelay[] = {
  1200, 1900, 1200, 6200,
  3550, 1400, 1000, 3500,
  4500, 7000
};

const uint8_t lyricBudget[][3] = {
  {2,1,1}, {1,1,2}, {2,1,1},
  {2,1,1}, {1,1,1}, {2,1,1},
  {2,2,2}, {2,1,1}, {2,2,2},
  {2,2,2}
};

const uint8_t TOTAL_LYRICS = 10;

// ------------------------------------------------
//  STATE MACHINES
// ------------------------------------------------
enum {MATRIX_EYE, MATRIX_HEARTLINE, MATRIX_HEARTS, MATRIX_DONE} matrixState = MATRIX_EYE;
enum {LYRIC_RUNNING, LYRIC_DONE} lyricState = LYRIC_RUNNING;

uint32_t matrixTimer = 0;
uint8_t  heartBlinkStep = 0;

uint32_t lyricTimer  = 0;
uint8_t  lyricIndex  = 0;

// ------------------------------------------------
//  LED MATRIX HELPERS
// ------------------------------------------------
void clearFrame() {
  for(int i=0;i<8;i++){
    for(int j=0;j<12;j++){
      frame[i][j] = 0;
    }
  }
}

void drawBitmap(const byte bmp[8]) {
  clearFrame();
  for(int row=0;row<8;row++) {
    for(int col=0;col<8;col++) {
      if((bmp[row] >> (7-col)) & 0x01) {
        frame[row][col+2] = 1;
      }
    }
  }
  matrix.renderBitmap(frame,8,12);
}

// ------------------------------------------------
//  LCD HELPERS
// ------------------------------------------------
void fadeIn(uint16_t ms, uint8_t steps = 32) {
  uint16_t delayPer = ms / steps;
  for (uint8_t s = 0; s <= steps; s++) {
    u8g2.setContrast(map(s, 0, steps, 0, 255));
    u8g2.sendBuffer();
    delay(delayPer);
  }
}

void fadeOut(uint16_t ms, uint8_t steps = 32) {
  uint16_t delayPer = ms / steps;
  for (uint8_t s = 0; s <= steps; s++) {
    u8g2.setContrast(map(s, 0, steps, 255, 0));
    u8g2.sendBuffer();
    delay(delayPer);
  }
  u8g2.clearBuffer();
  u8g2.sendBuffer();
  u8g2.setContrast(255);
}

void showLogo(uint16_t fadeTime = 1000) {
  u8g2.clearBuffer();
  u8g2.drawXBMP(0, 0, SCREEN_W, SCREEN_H, epd_bitmap);
  u8g2.sendBuffer();
  fadeIn(fadeTime);
  delay(500);
  fadeOut(fadeTime);
}

inline uint8_t textW(const char *s) {
  return u8g2.getStrWidth(s);
}

uint8_t tokenize(char *buf, char *words[], uint8_t maxWords) {
  uint8_t wc = 0;
  char *p = buf;
  while (wc < maxWords && *p) {
    while (*p == ' ') p++;
    if (!*p) break;
    words[wc++] = p;
    while (*p && *p != ' ') p++;
    if (*p) *p++ = '\0';
  }
  return wc;
}

void justifyLine(char *words[], uint8_t wc, int16_t y) {
  if (wc == 0) return;
  if (wc == 1) {
    u8g2.drawStr(0, y, words[0]);
    return;
  }
  int16_t totalW = 0;
  for (uint8_t i = 0; i < wc; i++) {
    totalW += textW(words[i]);
  }
  int16_t gaps  = wc - 1;
  int16_t space = SCREEN_W - totalW;
  int16_t extra = space / gaps;
  int16_t rem   = space % gaps;

  int16_t x = 0;
  for (uint8_t i = 0; i < wc; i++) {
    u8g2.drawStr(x, y, words[i]);
    x += textW(words[i]);
    if (i < wc - 1) {
      x += extra + (i < rem ? 1 : 0);
    }
  }
}

void displayJustifiedAnimated(const char *msg,
                              uint16_t wordDelay,
                              const uint8_t maxWordsLine[]) {
  uint32_t now = millis();

  // --------------------------------------------
  // Initialize for a new line (only once)
  // --------------------------------------------
  if (lyricWordsShown == 0) {
    strncpy(lyricBuffer, msg, BUF_SIZE - 1);
    lyricBuffer[BUF_SIZE - 1] = '\0';
    lyricWordCount = tokenize(lyricBuffer, lyricWords, MAX_WORDS);

    // Pre-compute which ROW (0,1,2) each word belongs to, based on the budget
    uint8_t curRow = 0;
    uint8_t wordsInCurRow = 0;
    for (uint8_t w = 0; w < lyricWordCount; w++) {
      if (wordsInCurRow >= maxWordsLine[curRow]) {
        curRow++;
        wordsInCurRow = 0;
      }
      wordRow[w]     = curRow;
      wordsInCurRow++;
    }

    currentWordDelay = wordDelay;
  }

  // --------------------------------------------
  // Draw words up to lyricWordsShown using justifyLine()
  // --------------------------------------------
  u8g2.clearBuffer();
  u8g2.setFont(u8g2_font_helvR14_tr);

  char* rowWords[MAX_WORDS];
  uint8_t rowCount;
  for (uint8_t row = 0; row < MAX_LINES; row++) {
    rowCount = 0;
    for (uint8_t w = 0; w < lyricWordsShown; w++) {
      if (wordRow[w] == row) {
        rowWords[rowCount++] = lyricWords[w];
      }
    }
    if (rowCount > 0) {
      int16_t y = LINE_HEIGHT + (row * LINE_HEIGHT);
      justifyLine(rowWords, rowCount, y);
    }
  }
  u8g2.sendBuffer();

  // --------------------------------------------
  // Step to next word or line
  // --------------------------------------------
  if (lyricWordsShown < lyricWordCount) {
  // reveal next word
  lyricWordsShown++;
  lyricTimer = now;
} else {
  // finished the whole line → wait for line delay then go to next line
  if (now - lyricTimer >= lyricLineDelay[lyricIndex]) {  // use line delay here
    lyricWordsShown = 0;
    lyricIndex++;
    lyricTimer = now;
  }
}
}

// ------------------------------------------------
//  SETUP
// ------------------------------------------------
void setup() {
  Serial.begin(115200);
  matrix.begin();
  u8g2.begin();

  showLogo();
  delay(2000);

  drawBitmap(eye);
  matrixTimer = millis();

  lyricTimer = millis();
  displayJustifiedAnimated(lyricText[lyricIndex], lyricDelay[lyricIndex], lyricBudget[lyricIndex]);
}

// ------------------------------------------------
//  LOOP
// ------------------------------------------------
void loop() {
  uint32_t now = millis();

  // --- LED MATRIX STATE MACHINE ---
  switch(matrixState) {
    case MATRIX_EYE:
      if(now - matrixTimer >= 500){
        matrix.autoscroll(500);
        matrix.loadSequence(LEDMATRIX_ANIMATION_HEARTBEAT_LINE);
        matrix.play(false);
        matrixState = MATRIX_HEARTLINE;
      }
      break;

    case MATRIX_HEARTLINE:
      if(matrix.sequenceDone()){
        matrixTimer = millis();
        heartBlinkStep = 0;
        drawBitmap(bheart);
        matrixState = MATRIX_HEARTS;
      }
      break;

    case MATRIX_HEARTS:
      if(now - matrixTimer >= 500){
        matrixTimer = now;
        heartBlinkStep++;
        if(heartBlinkStep == 1)      drawBitmap(sheart);
        else if(heartBlinkStep == 2) drawBitmap(bheart);
        else if(heartBlinkStep == 3) drawBitmap(sheart);
        else if(heartBlinkStep == 4) drawBitmap(bheart);
        else {
          drawBitmap(youbmp);
          matrixState = MATRIX_DONE;
        }
      }
      break;

    case MATRIX_DONE:
      // show the eye immediately and restart the sequence
      if(now - matrixTimer >= 800){       // optional pause on "YOU"
      drawBitmap(eye);
      matrixTimer = now;
      matrixState = MATRIX_EYE;
    }
      break;
  }

  // --- LCD LYRICS STATE MACHINE ---
  if(lyricState == LYRIC_RUNNING) {
  if(lyricIndex < TOTAL_LYRICS) {
    if(now - lyricTimer >= lyricDelay[lyricIndex]) {
      displayJustifiedAnimated(
        lyricText[lyricIndex],
        lyricDelay[lyricIndex],
        lyricBudget[lyricIndex]
      );
    }
  } else {
    lyricState = LYRIC_DONE;
  }
}
}
